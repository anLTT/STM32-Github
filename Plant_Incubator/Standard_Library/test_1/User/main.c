#include "stm32f10x.h"                  // Device header
#include "Delay.h"
#include "delay_1.h"
//#include "OLED.h"
#include "Key.h"
#include "Timer.h"
#include "lcd.h"




#include "SCD30.h"
#include "MyI2C.h"
#include "sys.h"


float Num1 = 10.0;
int8_t CO2 = 0;
int16_t Humi = 0;//显示和设定分开
uint8_t flag = 0;
uint8_t confirm_flag = 0;

u8 jiemian[] =
{
0x00,0x00,0x00,0x00,0x00,0x00,0x00,0x00,0x00,0x00,0x00,0x00,0x00,0x00,0x00,0x00,
0x00,0x00,0x00,0x00,0x00,0x00,0x00,0x00,0x00,0x00,0x00,0x00,0x00,0x00,0x00,0x00,
0x00,0x00,0x00,0x00,0x00,0x00,0x00,0x00,0x00,0x00,0x00,0x00,0x00,0x00,0x00,0x00,
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0x00,0x00,0x00,0x00,0x00,0x00,0x00,0x00,0x00,0x00,0x00,0x00,0x00,0x00,0x00,0x00,/*"D:\download\桌面\生成 UI 界面.bmp",0*/
};

int main(void)
{
	//注:延时不要用delay_ms,有范围限制


	SystemInit();//?????RCC 72MHZ
	delay_init(72);	     
	LCD_Init();	   


	//Key_Init();
	Timer_Init();
	
		uint8_t i=0;
		uint8_t read_statu;
		uint16_t CO2_s = 0; //ppm
		float Temperature_s = 0; //ppm
		uint16_t Humidity_s = 0; //ppm

	NVIC_PriorityGroupConfig(NVIC_PriorityGroup_2); //设置NVIC中断分组2:2位抢占优先级，2位响应优先级

		
    //SCD30_I2C2_Init();         // 初始化I2C2通信接口

	LCD_ShowChar_Large(0, 0, '1');

    // 启动SCD30连续测量
    uint8_t init_status = SCD30_StartContinuousMeas();
    if (init_status != 0) {
        LCD_Clear();
        LCD_ShowChar_Large(1, 1, 'F');
        LCD_ShowChar_Large(2, 1, 'C');
        while (1);  // 初始化失败则停留在此
    }

	LCD_Clear();
	    LCD_ShowChar_Large(1, 1, '1');
    Delay_ms(1000);
    LCD_Clear();

	SCD30_MeasData data;       // 存储传感器数据
    char display_buf[32];      // 显示缓冲区

	disp_240x160(jiemian);
	// delay_ms(1000);

	// 	for(Num1=0;Num1<1;Num1++)//预热计时3秒
	// {
	// 		LCD_ShowFloat_70(0, 0, Num1);
	// 	Delay_s(1);
	// }
	
	// 		SCD30_stopPeriodicMeasurement(1);
  	// SCD30_StartPeriodicMeasurement();
//	
//	LCD_Clear();
//		LCD_DrawPoint(0,0);
//	LCD_DrawPoint(3,1);
//			LCD_DrawPoint(2,2);
//				LCD_DrawPoint(1,3);
//	LCD_DrawPoint(3,0);
//	LCD_DrawPoint(4,1);
//	LCD_DrawPoint(5,2);
//	LCD_DrawPoint(6,3);
//	LCD_DrawPoint(7,4);
//	LCD_DrawPoint(0,80);

	// LCD_DrawLine_Mode(5,158,18,2);
	// LCD_DrawLine_Mode(20,158,18,2);	//只能是3的倍数
	// LCD_DrawLine_Mode(37,158,18,2);	
	// LCD_DrawLine_Mode(53,158,18,2);
	// LCD_DrawLine_Mode(70,158,18,2);
	
	// LCD_ClearLine_Mode(5,158,18,2);
	// Delay_s(1);
	// LCD_ClearLine_Mode(20,158,18,2);	//只能是3的倍数
	// Delay_s(1);
	// LCD_ClearLine_Mode(37,158,18,2);	
	// Delay_s(1);
	// LCD_ClearLine_Mode(53,158,18,2);
	// Delay_s(1);
	// LCD_ClearLine_Mode(70,158,18,2);

	
	while (1)
	{

		// 读取传感器数据
        uint8_t read_status = SCD30_ReadMeasData(&data);
        
        // 根据读取状态显示不同内容
        if (read_status == 0 && data.is_valid) {
            // //判断数据指标
            // if(data.co2_ppm > 2000||data.temperature_c > 35)  
			// {
			// 	LED1_ON();
			// 	LED2_OFF();
			// }
			// else 
			// {	
			// 	LED1_OFF();
			// 	LED2_ON();
			// }
			// 数据有效，显示测量值
            // 显示CO₂浓度
			LCD_ShowInt_3000_Large(14,3, data.co2_ppm);
			LCD_ShowChar_Large(0, 4, 'p');
			// sprintf(display_buf, "CO2: %.1f ppm", data.co2_ppm);
            // OLED_ShowString(1, 1, display_buf);
            
            // 显示温度
			LCD_ShowFloat_70_Large(14,50, data.temperature_c);
			LCD_ShowChar_Large(0, 10, '.');
            // sprintf(display_buf, "Temp: %.1f C", data.temperature_c);
            // OLED_ShowString(2, 1, display_buf);
            
            // 显示湿度
			LCD_ShowInt_3000_Large(14,97, data.humidity_rh);
			LCD_ShowChar_Large(0, 16, '.');	
            // sprintf(display_buf, "Humi: %.1f %%", data.humidity_rh);
            // OLED_ShowString(3, 1, display_buf);
        } else {
            // 数据无效，显示错误信息
            LCD_Clear();
			LCD_ShowChar_Large(1, 1, 'E');
			// sprintf(display_buf, "Code: %d", read_status);
            // OLED_ShowString(2, 1, display_buf);
		}


		switch (flag)
        {
            case 0:
				LCD_ClearLine_Mode(5,158,18,2);
				LCD_ClearLine_Mode(20,158,18,2);	//只能是3的倍数
				LCD_ClearLine_Mode(37,158,18,2);	
				LCD_ClearLine_Mode(53,158,18,2);
				LCD_ClearLine_Mode(70,158,18,2);

                LCD_DrawLine_Mode(5,158,18,2);
                
                break;
            case 1:
				LCD_ClearLine_Mode(5,158,18,2);
				LCD_ClearLine_Mode(20,158,18,2);	//只能是3的倍数
				LCD_ClearLine_Mode(37,158,18,2);	
				LCD_ClearLine_Mode(53,158,18,2);
				LCD_ClearLine_Mode(70,158,18,2);

				LCD_DrawLine_Mode(20, 158, 18, 2);

				break;
            case 2:
				LCD_ClearLine_Mode(5,158,18,2);
				LCD_ClearLine_Mode(20,158,18,2);	//只能是3的倍数
				LCD_ClearLine_Mode(37,158,18,2);	
				LCD_ClearLine_Mode(53,158,18,2);
				LCD_ClearLine_Mode(70,158,18,2);

				LCD_DrawLine_Mode(37, 158, 18, 2);
                break;
            case 3:
				LCD_ClearLine_Mode(5,158,18,2);
				LCD_ClearLine_Mode(20,158,18,2);	//只能是3的倍数
				LCD_ClearLine_Mode(37,158,18,2);	
				LCD_ClearLine_Mode(53,158,18,2);
				LCD_ClearLine_Mode(70,158,18,2);

				LCD_DrawLine_Mode(53, 158, 18, 2);
                break;
            case 4:
				LCD_ClearLine_Mode(5,158,18,2);
				LCD_ClearLine_Mode(20,158,18,2);	//只能是3的倍数
				LCD_ClearLine_Mode(37,158,18,2);	
				LCD_ClearLine_Mode(53,158,18,2);
				LCD_ClearLine_Mode(70,158,18,2);

				LCD_DrawLine_Mode(70, 158, 18, 2);
                break;
			case 6:
				flag = 0;
				break;

			default:
				break;
        }
//		LCD_ShowChar(0, 0, ' ');//不用这个.自己写的时候会直接将数据进行覆盖
//		LCD_ShowChar(0, 0, num + '0');
//		delay_ms(1000);
//		num++;
//		if(num > 9) num = 0;
//		LCD_ShowChar(0, 0, ' ');
//		LCD_ShowChar_Large(0, 0, num + '0');
//		delay_ms(200);
		
		/*示例1*/
//		if (Key_Check(KEY_1, KEY_HOLD))
//		{
//			Num1 = 1;
//		}
//		else
//		{
//			Num1 = 0;
//		}
//		if (Key_Check(KEY_2, KEY_HOLD))
//		{
//			Num2 = 1;
//		}
//		else
//		{
//			Num2 = 0;
//		}
		
		/*示例2*/
//		if (Key_Check(KEY_1, KEY_DOWN))
//		{
//			Num1 ++;
//		}
//		if (Key_Check(KEY_2, KEY_UP))
//		{
//			Num2 ++;
//		}
		
		/*示例3*/
//		if (Key_Check(KEY_1, KEY_SINGLE))
//		{
//			Num1 ++;
//		}
//		if (Key_Check(KEY_1, KEY_DOUBLE))
//		{
//			Num1 += 100;
//		}
//		if (Key_Check(KEY_2, KEY_SINGLE))
//		{
//			Num1 --;
//		}
//		if (Key_Check(KEY_2, KEY_DOUBLE))
//		{
//			Num1 -= 100;
//		}
//		if (Key_Check(KEY_1, KEY_LONG) || Key_Check(KEY_2, KEY_LONG))
//		{
//			Num1 = 0;
//		}
		
//		/*示例4*/
//		if (Key_Check(KEY_1, KEY_SINGLE) || Key_Check(KEY_1, KEY_REPEAT))
//		{
//			//Num1 ++;
//			//Num1 += 0.1;
//			CO2 += 1;
//			Humi += 1;
//		}
//		if (Key_Check(KEY_2, KEY_SINGLE) || Key_Check(KEY_2, KEY_REPEAT))
//		{
//			//Num1 -= 0.1;
//			CO2 -= 1;
//			Humi -= 1;
//		}
//		if (Key_Check(KEY_3, KEY_SINGLE))
//		{
//			Num1 = 0;
//		}
//		if (Key_Check(KEY_3, KEY_LONG))
//		{
//			Num1 = 9999;
//		}
		
		/*示例5*/
//		uint8_t K1_UP = Key_Check(KEY_1, KEY_UP);
//		uint8_t K2_UP = Key_Check(KEY_2, KEY_UP);
//		
//		if (K1_UP && Key_Check(KEY_3, KEY_HOLD))
//		{
//			Num1 ++;
//		}
//		if (K2_UP && Key_Check(KEY_3, KEY_HOLD))
//		{
//			Num1 --;
//		}
//		if (K1_UP && Key_Check(KEY_4, KEY_HOLD))
//		{
//			Num2 ++;
//		}
//		if (K2_UP && Key_Check(KEY_4, KEY_HOLD))
//		{
//			Num2 --;
//		}
		
				//LCD_ShowChar_Large(0, 0, Num1 + '0');
//				LCD_ShowFloat_70(0,0,Num1);

	 //Num1 = clamp_float(Num1, 0.0f, 70.0f);
	 //LCD_ShowFloat_70_Large(14, 3, Num1);
	// 			delay_ms(1000);
	// LCD_ShowFloat_70_Large(14, 50, Num1);
	// 			delay_ms(1000);					
	// 			LCD_ShowFloat_70_Large(14, 97, Num1);	
	// 			delay_ms(1000);	
	 //CO2 = clamp_int8(CO2, 0, 100);

	//LCD_ShowInt_3000_Large(14,50,CO2);
//					delay_ms(200);
//Humi = clamp_int16(Humi, 0, 3000);

	//LCD_ShowInt_3000_Large(14,97,Humi);
					//delay_ms(200);


	
// 		if(read_statu)
// 		{
// 			if(CO2_s && Temperature_s && Humidity_s)
				
// 			{			LCD_ShowInt_3000_Large(14,3,CO2_s);
// 				LCD_ShowFloat_70_Large(14,50,Temperature_s);
// 				LCD_ShowInt_3000_Large(14,97,Humidity_s);
// 				//Humi = CO2_s;
// //			printf("  %d ppm\r\n",CO2);
			
// 			Num1=0;
// 		}}
// 		//if(Humi)
// 		//{	//Humi = clamp_int16(Humi, 0, 3000);

// //	LCD_ShowInt_3000_Large(14,97,Humi);//}
// 			//disp_240x160(jiemian);
// 			 Num1 = clamp_float(Num1, 0.0f, 70.0f);
// 					LCD_ShowFloat_70(0, 0, Num1+= 0.1);
		
		
					// Delay_ms(200);
		        // 等待下一次测量（SCD30默认测量间隔为2秒）
        Delay_ms(2200);
		
		

			}
}

void TIM2_IRQHandler(void)
{
	if (TIM_GetITStatus(TIM2, TIM_IT_Update) == SET)
	{
		Key_Tick();
		TIM_ClearITPendingBit(TIM2, TIM_IT_Update);
	}
}
